## Config.in
```kconfig
source "$BR2_EXTERNAL_BRRRRRRRRRR_PATH/package/brightnessctl/Config.in"
source "$BR2_EXTERNAL_BRRRRRRRRRR_PATH/package/evsieve/Config.in"
source "$BR2_EXTERNAL_BRRRRRRRRRR_PATH/package/i3status-rust/Config.in"
source "$BR2_EXTERNAL_BRRRRRRRRRR_PATH/package/libretro-assets-ozone/Config.in"
source "$BR2_EXTERNAL_BRRRRRRRRRR_PATH/package/libretro-atari800/Config.in"
source "$BR2_EXTERNAL_BRRRRRRRRRR_PATH/package/libretro-beetle-ngp/Config.in"
source "$BR2_EXTERNAL_BRRRRRRRRRR_PATH/package/libretro-beetle-pce-fast/Config.in"
source "$BR2_EXTERNAL_BRRRRRRRRRR_PATH/package/libretro-beetle-wswan/Config.in"
source "$BR2_EXTERNAL_BRRRRRRRRRR_PATH/package/libretro-core-info/Config.in"
source "$BR2_EXTERNAL_BRRRRRRRRRR_PATH/package/libretro-desmume/Config.in"
source "$BR2_EXTERNAL_BRRRRRRRRRR_PATH/package/libretro-fbneo/Config.in"
source "$BR2_EXTERNAL_BRRRRRRRRRR_PATH/package/libretro-flycast/Config.in"
source "$BR2_EXTERNAL_BRRRRRRRRRR_PATH/package/libretro-gambatte/Config.in"
source "$BR2_EXTERNAL_BRRRRRRRRRR_PATH/package/libretro-genesisplusgx/Config.in"
source "$BR2_EXTERNAL_BRRRRRRRRRR_PATH/package/libretro-geolith/Config.in"
source "$BR2_EXTERNAL_BRRRRRRRRRR_PATH/package/libretro-hatari/Config.in"
source "$BR2_EXTERNAL_BRRRRRRRRRR_PATH/package/libretro-mame2003-plus/Config.in"
source "$BR2_EXTERNAL_BRRRRRRRRRR_PATH/package/libretro-mgba/Config.in"
source "$BR2_EXTERNAL_BRRRRRRRRRR_PATH/package/libretro-nestopia/Config.in"
source "$BR2_EXTERNAL_BRRRRRRRRRR_PATH/package/libretro-picodrive/Config.in"
source "$BR2_EXTERNAL_BRRRRRRRRRR_PATH/package/libretro-ppsspp/Config.in"
source "$BR2_EXTERNAL_BRRRRRRRRRR_PATH/package/libretro-prosystem/Config.in"
source "$BR2_EXTERNAL_BRRRRRRRRRR_PATH/package/libretro-snes9x/Config.in"
source "$BR2_EXTERNAL_BRRRRRRRRRR_PATH/package/libretro-snes9x2010/Config.in"
source "$BR2_EXTERNAL_BRRRRRRRRRR_PATH/package/libretro-stella2014/Config.in"
source "$BR2_EXTERNAL_BRRRRRRRRRR_PATH/package/libretro-swanstation/Config.in"
source "$BR2_EXTERNAL_BRRRRRRRRRR_PATH/package/libretro-vecx/Config.in"
source "$BR2_EXTERNAL_BRRRRRRRRRR_PATH/package/librga/Config.in"
source "$BR2_EXTERNAL_BRRRRRRRRRR_PATH/package/retroarch/Config.in"
source "$BR2_EXTERNAL_BRRRRRRRRRR_PATH/package/swayidle/Config.in"
source "$BR2_EXTERNAL_BRRRRRRRRRR_PATH/package/wob/Config.in"
```

## configs/rg353m_defconfig
```kconfig
BR2_aarch64=y
BR2_cortex_a55=y
BR2_TOOLCHAIN_EXTERNAL=y
BR2_TOOLCHAIN_EXTERNAL_GDB_SERVER_COPY=y
BR2_TARGET_OPTIMIZATION="-mtune=cortex-a55 -mcpu=cortex-a55+crc+crypto+fp+simd -O2 -U_FORTIFY_SOURCE -fno-stack-protector -fno-stack-clash-protection -fomit-frame-pointer"
BR2_CCACHE=y
BR2_OPTIMIZE_FAST=y
BR2_ENABLE_LTO=y
BR2_GLOBAL_PATCH_DIR="board/rg353m/patches"
BR2_SSP_NONE=y
BR2_RELRO_NONE=y
BR2_FORTIFY_SOURCE_NONE=y
BR2_TARGET_GENERIC_HOSTNAME="brrr"
BR2_TARGET_GENERIC_ISSUE="brrr"
BR2_ROOTFS_DEVICE_CREATION_DYNAMIC_EUDEV=y
BR2_TARGET_GENERIC_ROOT_PASSWD="brrr"
BR2_SYSTEM_BIN_SH_BASH=y
# BR2_TARGET_GENERIC_REMOUNT_ROOTFS_RW is not set
BR2_ROOTFS_OVERLAY="board/rg353m/rootfs_overlay"
BR2_ROOTFS_POST_BUILD_SCRIPT="board/rg353m/post-build.sh"
BR2_ROOTFS_POST_IMAGE_SCRIPT="board/rg353m/post-image.sh"
BR2_LINUX_KERNEL=y
BR2_LINUX_KERNEL_CUSTOM_VERSION=y
BR2_LINUX_KERNEL_CUSTOM_VERSION_VALUE="6.6.0-rc3"
BR2_LINUX_KERNEL_USE_CUSTOM_CONFIG=y
BR2_LINUX_KERNEL_CUSTOM_CONFIG_FILE="board/rg353m/linux.config"
BR2_LINUX_KERNEL_ZSTD=y
BR2_LINUX_KERNEL_DTS_SUPPORT=y
BR2_LINUX_KERNEL_DTB_IS_SELF_BUILT=y
BR2_LINUX_KERNEL_INTREE_DTS_NAME="rk3566-anbernic-rg353p.dts"
BR2_LINUX_KERNEL_NEEDS_HOST_LIBELF=y
BR2_PACKAGE_LINUX_TOOLS_PERF=y
BR2_PACKAGE_LINUX_TOOLS_PERF_TUI=y
BR2_PACKAGE_LINUX_TOOLS_PERF_NEEDS_HOST_PYTHON3=y
BR2_PACKAGE_BUSYBOX_CONFIG="board/rg353m/busybox.config"
BR2_PACKAGE_BUSYBOX_SHOW_OTHERS=y
BR2_PACKAGE_ALSA_UTILS=y
BR2_PACKAGE_ALSA_UTILS_ALSACONF=y
BR2_PACKAGE_ALSA_UTILS_AMIXER=y
BR2_PACKAGE_ALSA_UTILS_APLAY=y
BR2_PACKAGE_ALSA_UTILS_SPEAKER_TEST=y
BR2_PACKAGE_STRACE=y
BR2_PACKAGE_BTRFS_PROGS=y
BR2_PACKAGE_F2FS_TOOLS=y
BR2_PACKAGE_LIBGLVND=y
BR2_PACKAGE_MESA3D=y
BR2_PACKAGE_MESA3D_GALLIUM_DRIVER_PANFROST=y
BR2_PACKAGE_MESA3D_OPENGL_EGL=y
BR2_PACKAGE_MESA3D_OPENGL_ES=y
BR2_PACKAGE_ACPID=y
BR2_PACKAGE_EVTEST=y
BR2_PACKAGE_LINUXCONSOLETOOLS=y
BR2_PACKAGE_LINUXCONSOLETOOLS_JOYSTICK=y
BR2_PACKAGE_LINUXCONSOLETOOLS_FORCEFEEDBACK=y
BR2_PACKAGE_ROCKCHIP_RKBIN=y
BR2_PACKAGE_ROCKCHIP_RKBIN_TPL_FILENAME="bin/rk35/rk3568_ddr_1056MHz_v1.16.bin"
BR2_PACKAGE_ROCKCHIP_RKBIN_BL31_FILENAME="bin/rk35/rk3568_bl31_v1.42.elf"
BR2_PACKAGE_ALSA_PLUGINS=y
BR2_PACKAGE_LIBZIP=y
BR2_PACKAGE_SNAPPY=y
BR2_PACKAGE_LIBTOMCRYPT=y
BR2_PACKAGE_LIBOPENSSL_BIN=y
BR2_PACKAGE_CAIRO=y
BR2_PACKAGE_CAIRO_PNG=y
BR2_PACKAGE_JPEG=y
BR2_PACKAGE_LIBEPOXY=y
BR2_PACKAGE_LIBINPUT=y
BR2_PACKAGE_LIBXKBCOMMON=y
BR2_PACKAGE_LIBXML2=y
BR2_PACKAGE_ELFUTILS=y
BR2_PACKAGE_ELFUTILS_PROGS=y
BR2_PACKAGE_LIBFFI=y
BR2_PACKAGE_LIBUNWIND=y
BR2_PACKAGE_BRIGHTNESSCTL=y
BR2_PACKAGE_LIBRETRO_SNES9X2010=y
BR2_PACKAGE_EVSIEVE=y
BR2_PACKAGE_LIBTRACEEVENT=y
BR2_PACKAGE_IPERF3=y
BR2_PACKAGE_IW=y
BR2_PACKAGE_OPENSSH=y
# BR2_PACKAGE_OPENSSH_SANDBOX is not set
BR2_PACKAGE_RSYNC=y
BR2_PACKAGE_WPA_SUPPLICANT=y
BR2_PACKAGE_WPA_SUPPLICANT_WEXT=y
BR2_PACKAGE_FILE=y
BR2_PACKAGE_NEOFETCH=y
BR2_PACKAGE_HTOP=y
BR2_PACKAGE_KMOD_TOOLS=y
BR2_PACKAGE_NCDU=y
BR2_PACKAGE_UTIL_LINUX_RFKILL=y
BR2_PACKAGE_VIM=y
BR2_TARGET_ROOTFS_CPIO_DRACUT=y
BR2_TARGET_ROOTFS_CPIO_DRACUT_CONF_FILES="board/rg353m/dracut.conf"
BR2_TARGET_ROOTFS_INITRAMFS=y
BR2_TARGET_ROOTFS_SQUASHFS=y
BR2_TARGET_ROOTFS_SQUASHFS_BS_4K=y
BR2_TARGET_ROOTFS_SQUASHFS4_ZSTD=y
BR2_TARGET_ROOTFS_SQUASHFS_EXTREME_COMP=y
# BR2_TARGET_ROOTFS_TAR is not set
BR2_TARGET_UBOOT=y
BR2_TARGET_UBOOT_BUILD_SYSTEM_KCONFIG=y
BR2_TARGET_UBOOT_CUSTOM_GIT=y
BR2_TARGET_UBOOT_CUSTOM_REPO_URL="https://github.com/u-boot/u-boot.git"
BR2_TARGET_UBOOT_CUSTOM_REPO_VERSION="964aae164"
BR2_TARGET_UBOOT_BOARD_DEFCONFIG="anbernic-rgxx3-rk3566"
BR2_TARGET_UBOOT_NEEDS_PYLIBFDT=y
BR2_TARGET_UBOOT_NEEDS_PYELFTOOLS=y
BR2_TARGET_UBOOT_NEEDS_ROCKCHIP_RKBIN=y
# BR2_TARGET_UBOOT_FORMAT_BIN is not set
BR2_PACKAGE_HOST_BTRFS_PROGS=y
BR2_PACKAGE_HOST_DTC=y
BR2_PACKAGE_HOST_E2FSPROGS=y
BR2_PACKAGE_HOST_GENEXT2FS=y
BR2_PACKAGE_HOST_GENIMAGE=y
BR2_PACKAGE_HOST_PYTHON3_SSL=y
```

## configs/rgarc_defconfig
```kconfig
BR2_aarch64=y
BR2_cortex_a55=y
BR2_TOOLCHAIN_EXTERNAL=y
BR2_TOOLCHAIN_EXTERNAL_GDB_SERVER_COPY=y
BR2_TARGET_OPTIMIZATION="-mtune=cortex-a55 -mcpu=cortex-a55+crc+crypto+fp+simd -O2 -U_FORTIFY_SOURCE -fno-stack-protector -fno-stack-clash-protection -fomit-frame-pointer"
BR2_OPTIMIZE_FAST=y
BR2_ENABLE_LTO=y
BR2_PACKAGE_OVERRIDE_FILE="$(BR2_EXTERNAL_BRRRRRRRRRR_PATH)/external.mk $(CONFIG_DIR)/local.mk"
BR2_GLOBAL_PATCH_DIR="$(BR2_EXTERNAL_BRRRRRRRRRR_PATH)/patches $(BR2_EXTERNAL_BRRRRRRRRRR_PATH)/board/rgarc/patches"
BR2_REPRODUCIBLE=y
BR2_PER_PACKAGE_DIRECTORIES=y
BR2_SSP_NONE=y
BR2_RELRO_NONE=y
BR2_FORTIFY_SOURCE_NONE=y
BR2_TARGET_GENERIC_HOSTNAME="BRRRRRRRRRR"
BR2_TARGET_GENERIC_ISSUE="BRRRRRRRRRR"
BR2_ROOTFS_DEVICE_CREATION_DYNAMIC_EUDEV=y
BR2_TARGET_GENERIC_ROOT_PASSWD="BRRRRRRRRRR"
BR2_SYSTEM_BIN_SH_BASH=y
# BR2_TARGET_GENERIC_REMOUNT_ROOTFS_RW is not set
BR2_ROOTFS_OVERLAY="$(BR2_EXTERNAL_BRRRRRRRRRR_PATH)/board/rootfs_overlay $(BR2_EXTERNAL_BRRRRRRRRRR_PATH)/board/rgarc/rootfs_overlay"
BR2_ROOTFS_POST_BUILD_SCRIPT="$(BR2_EXTERNAL_BRRRRRRRRRR_PATH)/board/rgarc/post-build.sh"
BR2_ROOTFS_POST_IMAGE_SCRIPT="$(BR2_EXTERNAL_BRRRRRRRRRR_PATH)/board/rgarc/post-image.sh"
BR2_LINUX_KERNEL=y
BR2_LINUX_KERNEL_CUSTOM_VERSION=y
BR2_LINUX_KERNEL_CUSTOM_VERSION_VALUE="6.8.2"
BR2_LINUX_KERNEL_USE_CUSTOM_CONFIG=y
BR2_LINUX_KERNEL_CUSTOM_CONFIG_FILE="$(BR2_EXTERNAL_BRRRRRRRRRR_PATH)/board/rgarc/linux.config"
BR2_LINUX_KERNEL_DTS_SUPPORT=y
BR2_LINUX_KERNEL_DTB_IS_SELF_BUILT=y
BR2_LINUX_KERNEL_INTREE_DTS_NAME="rk3566-anbernic-rg-arc-d rk3566-anbernic-rg-arc-s"
BR2_LINUX_KERNEL_NEEDS_HOST_LIBELF=y
BR2_PACKAGE_BUSYBOX_CONFIG="$(BR2_EXTERNAL_BRRRRRRRRRR_PATH)/board/rgarc/busybox.config"
BR2_PACKAGE_BUSYBOX_SHOW_OTHERS=y
BR2_PACKAGE_ALSA_UTILS=y
BR2_PACKAGE_ALSA_UTILS_ALSACONF=y
BR2_PACKAGE_ALSA_UTILS_AMIXER=y
BR2_PACKAGE_ALSA_UTILS_APLAY=y
BR2_PACKAGE_ALSA_UTILS_SPEAKER_TEST=y
BR2_PACKAGE_ZSTD=y
BR2_PACKAGE_RT_TESTS=y
BR2_PACKAGE_STRACE=y
BR2_PACKAGE_JQ=y
BR2_PACKAGE_DOSFSTOOLS=y
BR2_PACKAGE_DOSFSTOOLS_FSCK_FAT=y
BR2_PACKAGE_SWAY=y
BR2_PACKAGE_FBGRAB=y
BR2_PACKAGE_LIBGLVND=y
BR2_PACKAGE_MESA3D=y
BR2_PACKAGE_MESA3D_GALLIUM_DRIVER_PANFROST=y
BR2_PACKAGE_MESA3D_OPENGL_EGL=y
BR2_PACKAGE_MESA3D_OPENGL_ES=y
BR2_PACKAGE_ACPID=y
BR2_PACKAGE_EVTEST=y
BR2_PACKAGE_GPTFDISK=y
BR2_PACKAGE_PARTED=y
BR2_PACKAGE_ROCKCHIP_RKBIN=y
BR2_PACKAGE_ROCKCHIP_RKBIN_TPL_FILENAME="bin/rk35/rk3568_ddr_1056MHz_v1.17.bin"
BR2_PACKAGE_ROCKCHIP_RKBIN_BL31_FILENAME="bin/rk35/rk3568_bl31_v1.43.elf"
BR2_PACKAGE_ALSA_LIB_PCM_PLUGINS="softvol"
# BR2_PACKAGE_ALSA_LIB_ALOAD is not set
# BR2_PACKAGE_ALSA_LIB_ALISP is not set
# BR2_PACKAGE_ALSA_LIB_OLD_SYMBOLS is not set
# BR2_PACKAGE_ALSA_LIB_TOPOLOGY is not set
BR2_PACKAGE_LIBZIP=y
BR2_PACKAGE_LZ4=y
BR2_PACKAGE_SNAPPY=y
BR2_PACKAGE_LIBOPENSSL_BIN=y
BR2_PACKAGE_LIBCURL=y
BR2_PACKAGE_LIBCURL_CURL=y
BR2_PACKAGE_CHRONY=y
BR2_PACKAGE_IFUPDOWN=y
BR2_PACKAGE_IPERF3=y
BR2_PACKAGE_IWD=y
BR2_PACKAGE_OPENSSH=y
# BR2_PACKAGE_OPENSSH_SANDBOX is not set
BR2_PACKAGE_RSYNC=y
BR2_PACKAGE_DIALOG=y
BR2_PACKAGE_FILE=y
BR2_PACKAGE_NEOFETCH=y
BR2_PACKAGE_HTOP=y
BR2_PACKAGE_KMOD_TOOLS=y
BR2_PACKAGE_NCDU=y
BR2_PACKAGE_SEATD_DAEMON=y
BR2_PACKAGE_VIM=y
BR2_TARGET_ROOTFS_EROFS=y
BR2_TARGET_ROOTFS_EROFS_LZ4HC=y
# BR2_TARGET_ROOTFS_TAR is not set
BR2_TARGET_UBOOT=y
BR2_TARGET_UBOOT_BUILD_SYSTEM_KCONFIG=y
BR2_TARGET_UBOOT_CUSTOM_GIT=y
BR2_TARGET_UBOOT_CUSTOM_REPO_URL="https://github.com/u-boot/u-boot.git"
BR2_TARGET_UBOOT_CUSTOM_REPO_VERSION="daa3100250839dd30626f7f4b7daf041f1114f1c"
BR2_TARGET_UBOOT_BOARD_DEFCONFIG="anbernic-rgxx3-rk3566"
BR2_TARGET_UBOOT_NEEDS_PYLIBFDT=y
BR2_TARGET_UBOOT_NEEDS_PYELFTOOLS=y
BR2_TARGET_UBOOT_NEEDS_ROCKCHIP_RKBIN=y
BR2_PACKAGE_HOST_E2FSPROGS=y
BR2_PACKAGE_HOST_GENEXT2FS=y
BR2_PACKAGE_HOST_GENIMAGE=y
BR2_PACKAGE_HOST_MTOOLS=y
BR2_PACKAGE_BRIGHTNESSCTL=y
BR2_PACKAGE_EVSIEVE=y
BR2_PACKAGE_LIBRETRO_ASSETS_OZONE=y
BR2_PACKAGE_LIBRETRO_ATARI800=y
BR2_PACKAGE_LIBRETRO_BEETLE_NGP=y
BR2_PACKAGE_LIBRETRO_BEETLE_PCE_FAST=y
BR2_PACKAGE_LIBRETRO_BEETLE_WSWAN=y
BR2_PACKAGE_LIBRETRO_CORE_INFO=y
BR2_PACKAGE_LIBRETRO_FBNEO=y
BR2_PACKAGE_LIBRETRO_FLYCAST=y
BR2_PACKAGE_LIBRETRO_GAMBATTE=y
BR2_PACKAGE_LIBRETRO_GENESISPLUSGX=y
BR2_PACKAGE_LIBRETRO_GEOLITH=y
BR2_PACKAGE_LIBRETRO_HATARI=y
BR2_PACKAGE_LIBRETRO_MGBA=y
BR2_PACKAGE_LIBRETRO_NESTOPIA=y
BR2_PACKAGE_LIBRETRO_PICODRIVE=y
BR2_PACKAGE_LIBRETRO_PPSSPP=y
BR2_PACKAGE_LIBRETRO_PROSYSTEM=y
BR2_PACKAGE_LIBRETRO_SNES9X=y
BR2_PACKAGE_LIBRETRO_STELLA2014=y
BR2_PACKAGE_LIBRETRO_SWANSTATION=y
BR2_PACKAGE_LIBRETRO_VECX=y
BR2_PACKAGE_RETROARCH=y
```

## package/brightnessctl/Config.in
```kconfig
config BR2_PACKAGE_BRIGHTNESSCTL
	bool "brightnessctl"
	help
        brightnessctl
```

## package/evsieve/Config.in
```kconfig
config BR2_PACKAGE_EVSIEVE
	bool "evsieve"
	depends on BR2_PACKAGE_HOST_RUSTC_TARGET_ARCH_SUPPORTS
	select BR2_PACKAGE_HOST_RUSTC
	help
        evsieve
```

## package/i3status-rust/Config.in
```kconfig
config BR2_PACKAGE_I3STATUS_RUST
	bool "i3status_rust"
	depends on BR2_PACKAGE_HOST_RUSTC_TARGET_ARCH_SUPPORTS
	select BR2_PACKAGE_ALSA_UTILS
	select BR2_PACKAGE_HOST_RUSTC
	select BR2_PACKAGE_LM_SENSORS
	select BR2_PACKAGE_UPOWER
	help
        i3status_rust
```

## package/i3status/Config.in
```kconfig
config BR2_PACKAGE_I3STATUS
	bool "i3status"
	depends on BR2_PACKAGE_HOST_RUSTC_TARGET_ARCH_SUPPORTS
	select BR2_PACKAGE_HOST_RUSTC
	select BR2_PACKAGE_LIBNL
	select BR2_PACKAGE_YAJL
	select BR2_PACKAGE_LIBCONFUSE
	select BR2_PACKAGE_ALSA_LIB
	help
        i3status
```

## package/libretro-assets-ozone/Config.in
```kconfig
config BR2_PACKAGE_LIBRETRO_ASSETS_OZONE
	bool "libretro-assets-ozone"
	depends on BR2_PACKAGE_RETROARCH
	help
      Ozone assets for RetroArch
```

## package/libretro-atari800/Config.in
```kconfig
config BR2_PACKAGE_LIBRETRO_ATARI800
	bool "libretro-atari800"
	depends on BR2_PACKAGE_RETROARCH
	help
		Atari800
```

## package/libretro-beetle-pce-fast/Config.in
```kconfig
config BR2_PACKAGE_LIBRETRO_BEETLE_PCE_FAST
        bool "libretro-beetle-pce-fast"
        depends on BR2_PACKAGE_RETROARCH
        depends on BR2_INSTALL_LIBSTDCPP
        help
          A libretro NEC PC Engine / CD emulator core (Beetle PCE FAST) for ARM.

          http://www.libretro.com

comment "LIBRETRO_BEETLE_PCE_FAST needs a toolchain w/ C++"
        depends on !BR2_INSTALL_LIBSTDCPP
```

## package/libretro-core-info/Config.in
```kconfig
config BR2_PACKAGE_LIBRETRO_CORE_INFO
	bool "libretro-core-info"
	depends on BR2_PACKAGE_RETROARCH
	help
	  http://www.libretro.com
```

## package/libretro-geolith/Config.in
```kconfig
config BR2_PACKAGE_LIBRETRO_GEOLITH
	bool "libretro-neolith"
	depends on BR2_PACKAGE_RETROARCH
	depends on BR2_INSTALL_LIBSTDCPP
	help
	  Geolith is a highly accurate emulator for the Neo Geo AES and MVS.

	  https://github.com/libretro/geolith-libretro

comment "LIBRETRO_GEOLITH needs a toolchain w/ C++"
	depends on !BR2_INSTALL_LIBSTDCPP
```

## package/libretro-hatari/Config.in
```kconfig
config BR2_PACKAGE_LIBRETRO_HATARI
	bool "libretro-hatari"
	depends on BR2_PACKAGE_RETROARCH
	help
		hatari
```

## package/libretro-picodrive/Config.in
```kconfig
config BR2_PACKAGE_LIBRETRO_PICODRIVE
	bool "libretro-picodrive"
	depends on BR2_PACKAGE_RETROARCH
	help
		picodrive
```

## package/libretro-snes9x2010/Config.in
```kconfig
config BR2_PACKAGE_LIBRETRO_SNES9X2010
	bool "libretro-snes9x2010"
	help
	  Snes9x
```

## package/libretro-stella2014/Config.in
```kconfig
config BR2_PACKAGE_LIBRETRO_STELLA2014
	bool "libretro-stella2014"
	depends on BR2_PACKAGE_RETROARCH
	help
		stella2014
```

## package/retroarch/Config.in
```kconfig
config BR2_PACKAGE_RETROARCH
	bool "retroarch"
    depends on BR2_PACKAGE_EUDEV
    depends on BR2_PACKAGE_LIBDRM
    depends on BR2_PACKAGE_ALSA_LIB
    depends on BR2_PACKAGE_FREETYPE
    depends on BR2_PACKAGE_LIBPNG
    #depends on BR2_PACKAGE_SDL2
    #depends on BR2_PACKAGE_LIBGLVND
	help
        retroarch
```

## package/wob/Config.in
```kconfig
config BR2_PACKAGE_WOB
	select BR2_PACKAGE_INIH
	select BR2_PACKAGE_WAYLAND
	select BR2_PACKAGE_WAYLAND_PROTOCOLS
	bool "wob"
	help
        wayland overlay bar
```
